## config/west.yml
```yaml
manifest:
  remotes:
    - name: zmk
      url-base: https://github.com/zmkfirmware
  projects:
    - name: zmk
      remote: zmk
      revision: v0.3.0
      import: app/west.yml
  self:
    path: config
```
